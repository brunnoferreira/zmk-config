## config/west.yml
```yaml
manifest:
  remotes:
    - name: zmkfirmware
      url-base: https://github.com/zmkfirmware
    # Custom Shield
    - name: m165437
      url-base: https://github.com/M165437
    # Custom Shield (nice_oled and nice_epaper)
    - name: mctechnology17
      url-base: https://github.com/mctechnology17
  projects:
    - name: zmk
      remote: zmkfirmware
      revision: v0.2.1
      import: app/west.yml
    # Custom Shield
    - name: nice-view-gem
      remote: m165437
      revision: main
      # Custom Shield (nice_oled and nice_epaper)
    - name: zmk-nice-oled
      remote: mctechnology17
      revision: main
  self:
    path: config
```
